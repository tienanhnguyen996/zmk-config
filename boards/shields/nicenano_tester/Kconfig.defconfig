## boards/shields/nicenano_tester/Kconfig.defconfig
```kconfig
# Copyright (c) 2026 The ZMK Contributors
# SPDX-License-Identifier: MIT

if SHIELD_NICENANO_TESTER

config ZMK_KEYBOARD_NAME
    default "NiceNanoTester"

endif
```

## boards/shields/nicenano_tester/Kconfig.shield
```kconfig
# Copyright (c) 2026 The ZMK Contributors
# SPDX-License-Identifier: MIT

config SHIELD_NICENANO_TESTER
    def_bool $(shields_list_contains,nicenano_tester)
```

## boards/shields/xiao_test_dongle/Kconfig.defconfig
```kconfig
# Copyright (c) 2026 The ZMK Contributors
# SPDX-License-Identifier: MIT

if SHIELD_XIAO_TEST_DONGLE

config ZMK_KEYBOARD_NAME
    default "XiaoTestDongle"

config ZMK_SPLIT_ROLE_CENTRAL
    default y

config ZMK_SPLIT
    default y

# We have 1 peripheral (the xiao_test keyboard itself)
config ZMK_SPLIT_BLE_CENTRAL_PERIPHERALS
    default 1

# Max profiles
config BT_MAX_CONN
    default 6

config BT_MAX_PAIRED
    default 6

endif
```

## config/west.yml
```yaml
manifest:
  defaults:
    revision: v0.3
  remotes:
    - name: zmkfirmware
      url-base: https://github.com/zmkfirmware
    - name: englmaxi
      url-base: https://github.com/englmaxi
    # Additional modules containing boards/shields/custom code can be listed here as well
    # See https://docs.zephyrproject.org/3.2.0/develop/west/manifest.html#projects
  projects:
    - name: zmk
      remote: zmkfirmware
      import: app/west.yml
    - name: zmk-dongle-display
      url: https://github.com/tienanhnguyen996/zmk-Keebgotchi
      revision: c6c4be11c5ede722086a2a1f355cec9c101b9390
  self:
    path: config
```

#include <behaviors.dtsi>
#include <dt-bindings/zmk/keys.h>

/ {
    keymap {
        compatible = "zmk,keymap";

        default_layer {
            bindings = <
                &none &kp B &kp C &kp D &kp E &kp F &kp G &kp H &kp I &kp J &kp K
            >;
        };
    };
};

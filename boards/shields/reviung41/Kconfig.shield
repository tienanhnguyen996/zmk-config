## boards/shields/reviung41/Kconfig.shield
```kconfig
# Copyright (c) 2020 The ZMK Contributors
# SPDX-License-Identifier: MIT

config SHIELD_REVIUNG41_DONGLE
    def_bool $(shields_list_contains,reviung41_dongle)
```

## boards/shields/xiao_test/Kconfig.defconfig
```kconfig
# Copyright (c) 2026 The ZMK Contributors
# SPDX-License-Identifier: MIT

if SHIELD_XIAO_TEST

config ZMK_KEYBOARD_NAME
    default "XIAO Test"

config ZMK_SPLIT
    default y

config ZMK_SPLIT_ROLE_CENTRAL
    default n

endif
```

## boards/shields/xiao_test/Kconfig.shield
```kconfig
# Copyright (c) 2026 The ZMK Contributors
# SPDX-License-Identifier: MIT

config SHIELD_XIAO_TEST
    def_bool $(shields_list_contains,xiao_test)
    select ZMK_SPLIT
```

## boards/shields/xiao_test_dongle/Kconfig.shield
```kconfig
# Copyright (c) 2026 The ZMK Contributors
# SPDX-License-Identifier: MIT

config SHIELD_XIAO_TEST_DONGLE
    def_bool $(shields_list_contains,xiao_test_dongle)
    select ZMK_SPLIT
    select ZMK_SPLIT_ROLE_CENTRAL
```

## boards/shields/xiao_test_std/Kconfig.defconfig
```kconfig
# Copyright (c) 2026 The ZMK Contributors
# SPDX-License-Identifier: MIT

if SHIELD_XIAO_TEST_STD

config ZMK_KEYBOARD_NAME
    default "XIAO Std"

config ZMK_SPLIT
    default y

config ZMK_SPLIT_ROLE_CENTRAL
    default n

endif
```

## boards/shields/xiao_test_std/Kconfig.shield
```kconfig
# Copyright (c) 2026 The ZMK Contributors
# SPDX-License-Identifier: MIT

config SHIELD_XIAO_TEST_STD
    def_bool $(shields_list_contains,xiao_test_std)
    select ZMK_SPLIT
```

## boards/shields/xiao_test_std_dongle/Kconfig.shield
```kconfig
# Copyright (c) 2026 The ZMK Contributors
# SPDX-License-Identifier: MIT

config SHIELD_XIAO_TEST_STD_DONGLE
    def_bool $(shields_list_contains,xiao_test_std_dongle)
    select ZMK_SPLIT
    select ZMK_SPLIT_ROLE_CENTRAL
```
